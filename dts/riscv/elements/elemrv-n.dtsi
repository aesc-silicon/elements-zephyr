/*
 * Copyright (c) 2025 aesc silicon
 *
 * SPDX-License-Identifier: Apache-2.0
 */

#include <elements/nitrogen.dtsi>

/ {
	#address-cells = <1>;
	#size-cells = <1>;

	soc {
		#address-cells = <1>;
		#size-cells = <1>;
		compatible = "elements,nitrogen-soc", "simple-bus";
		ranges;
	};
};
