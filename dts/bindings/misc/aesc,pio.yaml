## dts/bindings/misc/aesc,pio.yaml
```yaml
# SPDX-FileCopyrightText: 2026 Aesc Silicon
# SPDX-License-Identifier: Apache-2.0

description: |
  Aesc Silicon Programmable IO controller.

  A programmable state machine that executes a user-defined instruction
  sequence from on-chip program memory to drive and sample IO pins without
  continuous CPU intervention.

  Example node:

    pio0: pio@10010000 {
      compatible = "aesc,pio";
      reg = <0x10010000 0x100>;
      clock-frequency = <50000000>;
      aesc,clock-divider = <49>;
      aesc,read-delay = <2>;
    };

compatible: "aesc,pio"

include: [pinctrl-device.yaml, base.yaml]

properties:
  reg:
    required: true

  clock-frequency:
    type: int
    required: true
    description: |
      Input clock frequency in Hz. Used by the driver to compute the
      clock divider register value from a desired tick frequency.

  aesc,tick-frequency:
    type: int
    required: false
    description: |
      Frequency in Hz of the internal clock-divider tick used by WAIT, READ
      and LOOP instructions. The driver computes the clock divider register
      value as:

        clockDivider = (clock-frequency / aesc,tick-frequency) - 1

      Requires clock-frequency to be set. Must evenly divide clock-frequency;
      if it does not, the result is rounded down and the actual tick frequency
      will be slightly lower than requested.

  aesc,read-delay:
    type: int
    required: false
    default: 0
    description: |
      Number of clock-divider ticks to wait after setting a pin to input
      before sampling it during a READ instruction. Allows the line to
      settle before capture.
```

## dts/bindings/pwm/aesc,pwm.yaml
```yaml
# SPDX-FileCopyrightText: 2026 Aesc Silicon
# SPDX-License-Identifier: Apache-2.0

title: Aesc Silicon PWM Controller

description: |
  Aesc Silicon multi-channel PWM controller IP core. Supports edge-aligned
  and center-aligned modes, complementary outputs, dead-time insertion,
  N-shot operation, and phase offset for multi-phase applications.

compatible: "aesc,pwm"

include: [pwm-controller.yaml, pinctrl-device.yaml, base.yaml]

properties:
  reg:
    required: true

  interrupts:
    required: true

  input-frequency:
    type: int
    required: true
    description: |
      System clock frequency in Hz fed into the IP core. Used by the driver
      to report the cycle rate via get_cycles_per_sec().

  pinctrl-0:
    required: true

  pinctrl-names:
    required: true

pwm-cells:
  - channel
  - period
  - flags
```

## dts/bindings/pwm/elements,pwm.yaml
```yaml
# Copyright (c) 2024, aesc silicon
# SPDX-License-Identifier: Apache-2.0


description: ELements PWM

include: [pwm-controller.yaml, base.yaml]

compatible: "elements,pwm"

properties:

  clock-frequency:
    type: int
    required: true
    description: Default PWM Peripheral Clock frequency in Hz

  channels:
    type: int
    required: true
    description: Number of channels this PWM has

  reg:
    required: true

  "#pwm-cells":
    const: 3

pwm-cells:
  - channel
  - period
  - flags
```

## dts/bindings/reset/elements,rst.yaml
```yaml
# Copyright (c) 2025, aesc silicon
# SPDX-License-Identifier: Apache-2.0

description: |
  Gigadevice Reset and Clock Unit (RCU) if a multi-function peripheral in
  charge of reset control (RCTL) and clock control (CCTL) for all SoC
  peripherals. This binding represents the reset controller (RCTL).

  To specify the reset line in a peripheral, the standard resets property needs
  to be used, e.g.:

    gpioa: gpio@xxx {
        ...
        /* cell encodes RCU register offset and control bit position */
        resets = <&rctl GD32_RESET_GPIOA>;
        ...
    }

  Predefined RCU reset cells are available in
  include/zephyr/dts-bindings/reset/gd32{xxx}.h header files, where {xxx}
  corresponds to the SoC series, e.g. f4xx.

compatible: "elements,rst"

include: [reset-controller.yaml, base.yaml]

reset-cells:
  - id
```

## dts/bindings/serial/elements,uart.yaml
```yaml
#
# Copyright (c) 2021 Phytec Messtechnik GmbH
#
# SPDX-License-Identifier: Apache-2.0
#
---

description: Elements UART - This binding gives a base representation of the Elements UART

compatible: "elements,uart"

# inherits:
include: uart-controller.yaml

properties:
    reg:
      type: array
      description: mmio register space
      required: true

    interrupts:
      type: array
      required: true
      description: required interrupts
```

## dts/bindings/serial/hydrogen,uart.yaml
```yaml
#
# Copyright (c) 2019 Phytec Messtechnik GmbH
#
# SPDX-License-Identifier: Apache-2.0
#
---

description: Hydorgen UART - This binding gives a base representation of the Hydrogen UART

compatible: "hydrogen,uart"

# inherits:
include: uart-controller.yaml

properties:
    reg:
      type: array
      description: mmio register space
      required: true

    interrupts:
      type: array
      required: true
      description: required interrupts


...
```

## dts/bindings/spi/elements,spi.yaml
```yaml
#
# Copyright (c) 2021, Phytec Messtechnik GmbH
#
# SPDX-License-Identifier: Apache-2.0
#
---
compatible: "elements,spi"

description: Elements SPI driver - This binding gives a base representation of the Elements SPI controller


include: spi-controller.yaml

properties:
    reg:
      type: array
      description: mmio register space
      required: true

    interrupts:
      type: array
      description: required interrupts
```

## dts/bindings/spi/hydrogen,spi.yaml
```yaml
#
# Copyright (c) 2019, Phytec Messtechnik GmbH
#
# SPDX-License-Identifier: Apache-2.0
#
---
compatible: "hydrogen,spi"

description: Hydrogen SPI driver - This binding gives a base representation of the Hydrogen SPI controller


include: spi-controller.yaml

properties:
    reg:
      type: array
      description: mmio register space
      required: true

    interrupts:
      type: array
      description: required interrupts
```

## dts/bindings/timer/elements,machine-timer.yaml
```yaml
# Copyright (c) 2024 aesc silicon
# SPDX-License-Identifier: Apache-2.0

description: |
  Elements Machine Timer

  The elements machine timer provides RISC-V privileged mtime and mtimecmp
  registers.

compatible: "elements,machine-timer"

include: base.yaml

properties:
  reg:
    required: true

  interrupts:
    required: true
```

## soc/aesc/hydrogen/Kconfig
```kconfig
# Copyright (c) 2026 Aesc Silicon
# SPDX-License-Identifier: Apache-2.0

config SOC_SERIES_HYDROGEN
	select RISCV
	select RISCV_PRIVILEGED
	select RISCV_HAS_PLIC
	select INCLUDE_RESET_VECTOR
	select PINCTRL
	select SYSCON

config SOC_PART_NUMBER
	default "elemrv_h" if SOC_ELEMRV_H
```

## soc/elements/vexriscv/Kconfig.defconfig
```kconfig
# Copyright (c) 2024 aesc silicon
# SPDX-License-Identifier: Apache-2.0

if SOC_FAMILY_ELEMENTS_VEXRISCV

rsource "*/Kconfig.defconfig"

endif # SOC_FAMILY_ELEMENTS_VEXRISCV
```

## soc/elements/vexriscv/Kconfig.soc
```kconfig
# Copyright (c) 2024 aesc silicon
# SPDX-License-Identifier: Apache-2.0

config SOC_FAMILY_ELEMENTS_VEXRISCV
	bool

config SOC_FAMILY
	default "vexriscv_elements" if SOC_FAMILY_ELEMENTS_VEXRISCV

rsource "*/Kconfig.soc"
```

## soc/elements/vexriscv/helium/Kconfig
```kconfig
# Copyright (c) 2024 aesc silicon
# SPDX-License-Identifier: Apache-2.0

config SOC_SERIES_HELIUM
	select RISCV
	select RISCV_PRIVILEGED
	select INCLUDE_RESET_VECTOR
	select ATOMIC_OPERATIONS_C
	select RISCV_ISA_RV32I
	select RISCV_ISA_EXT_M
	select RISCV_ISA_EXT_C
	select RISCV_ISA_EXT_ZICSR
	select RISCV_ISA_EXT_ZIFENCEI

config SOC_PART_NUMBER
	default "helium1" if SOC_HELIUM1
	default "helium2" if SOC_HELIUM2
```

## soc/elements/vexriscv/helium/Kconfig.defconfig
```kconfig
# Copyright (c) 2024 aesc silicon
# SPDX-License-Identifier: Apache-2.0

if SOC_SERIES_HELIUM

config SYS_CLOCK_HW_CYCLES_PER_SEC
	default 100000000

config SYS_CLOCK_TICKS_PER_SEC
	default 10000

config RISCV_SOC_INTERRUPT_INIT
	default y

config RISCV_MACHINE_TIMER
	default y

config RISCV_HAS_PLIC
	default y

config MULTI_LEVEL_INTERRUPTS
	default y

config 2ND_LEVEL_INTERRUPTS
	default y

config 2ND_LVL_ISR_TBL_OFFSET
	default 12

config 2ND_LVL_INTR_00_OFFSET
	default 12

config NUM_IRQS
	default 32

config GEN_ISR_TABLES
	default y

config XIP
	default n

config REBOOT
	default y

config REBOOT_ADDRESS
	hex
	default 0xf0021000

endif # SOC_SERIES_HELIUM
```

## soc/elements/vexriscv/helium/Kconfig.soc
```kconfig
# Copyright (c) 2024 aesc silicon
# SPDX-License-Identifier: Apache-2.0

config SOC_SERIES_HELIUM
	bool
	select SOC_FAMILY_ELEMENTS_VEXRISCV

config SOC_HELIUM1
	bool
	select SOC_SERIES_HELIUM

config SOC_HELIUM2
	bool
	select SOC_SERIES_HELIUM

config SOC_SERIES
	default "helium" if SOC_SERIES_HELIUM

config SOC
	default "helium1" if SOC_HELIUM1
	default "helium2" if SOC_HELIUM2
```

## soc/elements/vexriscv/helium/Kconfig.soc.backup
```kconfig
config SOC
	default "elements-vexriscv"

config SYS_CLOCK_HW_CYCLES_PER_SEC
	default 100000000

config RISCV_SOC_INTERRUPT_INIT
	default y

config RISCV_MACHINE_TIMER
	default y

config RISCV_HAS_PLIC
	default y

config 2ND_LEVEL_INTERRUPTS
	default y

config 2ND_LVL_ISR_TBL_OFFSET
	default 12

config 2ND_LVL_INTR_00_OFFSET
	default 12

config NUM_IRQS
	default 32

config GEN_ISR_TABLES
	default y

config XIP
	default n

config REBOOT_ADDRESS
	default 0xf0021000

endif # SOC_RISCV32_ELEMENTS_VEXRISCV
```

## soc/elements/vexriscv/hydrogen/Kconfig.soc
```kconfig
# Copyright (c) 2025 aesc silicon
# SPDX-License-Identifier: Apache-2.0

config SOC_SERIES_HYDROGEN
	bool
	select SOC_FAMILY_ELEMENTS_VEXRISCV

config SOC_ELEMRV1
	bool
	select SOC_SERIES_HYDROGEN

config SOC_SERIES
	default "hydrogen" if SOC_SERIES_HYDROGEN

config SOC
	default "elemrv1" if SOC_ELEMRV1
```

## soc/elements/vexriscv/nitrogen/Kconfig.defconfig
```kconfig
# Copyright (c) 2025 aesc silicon
# SPDX-License-Identifier: Apache-2.0

if SOC_SERIES_NITROGEN

config SYS_CLOCK_HW_CYCLES_PER_SEC
	default $(dt_node_int_prop_int,/cpus/cpu@0,clock-frequency)

config SYS_CLOCK_TICKS_PER_SEC
	default 1000

config NUM_IRQS
	default 12

config XIP
	default n

config REBOOT
	default n

endif # SOC_SERIES_NITROGEN
```

## soc/elements/vexriscv/nitrogen/Kconfig.soc
```kconfig
# Copyright (c) 2025 aesc silicon
# SPDX-License-Identifier: Apache-2.0

config SOC_SERIES_NITROGEN
	bool
	select SOC_FAMILY_ELEMENTS_VEXRISCV

config SOC_ELEMRV_N
	bool
	select SOC_SERIES_NITROGEN

config SOC_SERIES
	default "nitrogen" if SOC_SERIES_NITROGEN

config SOC
	default "elemrv-n" if SOC_ELEMRV_N
```

## soc/riscv/elements-vexriscv/Kconfig.soc
```kconfig
config SOC_RISCV32_ELEMENTS_VEXRISCV
	bool "Elements RISC-V implementation"
        select RISCV_PRIVILEGED
	select INCLUDE_RESET_VECTOR
	select ATOMIC_OPERATIONS_C
	select RISCV_ISA_RV32I
	select RISCV_ISA_EXT_M
	select RISCV_ISA_EXT_C
	select RISCV_ISA_EXT_ZICSR
	select RISCV_ISA_EXT_ZIFENCEI

if SOC_RISCV32_ELEMENTS_VEXRISCV

config SOC
	default "elements-vexriscv"

config SYS_CLOCK_HW_CYCLES_PER_SEC
	default 100000000

config RISCV_SOC_INTERRUPT_INIT
	default y

config RISCV_MACHINE_TIMER
	default y

config RISCV_HAS_PLIC
	default y

config 2ND_LEVEL_INTERRUPTS
	default y

config 2ND_LVL_ISR_TBL_OFFSET
	default 12

config 2ND_LVL_INTR_00_OFFSET
	default 12

config NUM_IRQS
	default 32

config GEN_ISR_TABLES
	default y

config XIP
	default n

endif # SOC_RISCV32_ELEMENTS_VEXRISCV
```

## soc/riscv/riscv-privilege/elements-vexriscv/Kconfig.defconfig.series
```kconfig
if SOC_SERIES_RISCV32_ELEMENTS_VEXRISCV

config SOC_SERIES
	default "elements-vexriscv"

config SYS_CLOCK_HW_CYCLES_PER_SEC
	default 100000000

config RISCV_SOC_INTERRUPT_INIT
	default y

config RISCV_HAS_CPU_IDLE
	default n

config RISCV_MACHINE_TIMER
	default y

config RISCV_HAS_PLIC
	default y

config 2ND_LEVEL_INTERRUPTS
	default y

config 2ND_LVL_ISR_TBL_OFFSET
	default 12

config 2ND_LVL_INTR_00_OFFSET
	default 11

config NUM_IRQS
	default 32

config GEN_ISR_TABLES
	default y

config XIP
	default n

endif # SOC_SERIES_RISCV32_ELEMENTS_VEXRISCV
```

## soc/riscv/riscv-privilege/elements-vexriscv/Kconfig.soc
```kconfig
choice
prompt "Elements implementations"
depends on SOC_SERIES_RISCV32_ELEMENTS_VEXRISCV

config SOC_RISCV32_ELEMENTS_VEXRISCV
	bool "Elements RISC-V implementation"
	select INCLUDE_RESET_VECTOR
	select ATOMIC_OPERATIONS_C
	select RISCV_ISA_RV32I
	select RISCV_ISA_EXT_M
	select RISCV_ISA_EXT_C
	select RISCV_ISA_EXT_ZICSR
	#select RISCV_ISA_EXT_ZIFENCEI

endchoice
```

## soc/riscv/riscv-privilege/elements/Kconfig.series
```kconfig
config SOC_SERIES_RISCV32_ELEMENTS
	bool "Elements implementation"
	select SOC_FAMILY_RISCV_PRIVILEGE
	select HAS_DTS
	select INCLUDE_RESET_VECTOR
	help
	  Enable support for Elements SOCs
```

## soc/riscv/riscv-privilege/elements/Kconfig.soc
```kconfig
choice
prompt "Elements implementations"
depends on SOC_SERIES_RISCV32_ELEMENTS

config SOC_RISCV32_ELEMENTS
	bool "Elements implementation"
	select ATOMIC_OPERATIONS_C
	select INCLUDE_RESET_VECTOR

endchoice
```

## soc/riscv/riscv-privilege/hydrogen/Kconfig.defconfig.series
```kconfig
if SOC_SERIES_RISCV32_HYDROGEN

config SOC_SERIES
	string
	default "hydrogen"

config SYS_CLOCK_HW_CYCLES_PER_SEC
	int
	default 100000000

config RISCV_SOC_INTERRUPT_INIT
	bool
	default n

config RISCV_HAS_CPU_IDLE
	bool
	default n

config RISCV_HAS_PLIC
	bool
	default y

config NUM_IRQS
	int
	default 20

config XIP
	bool
	default n

endif # SOC_SERIES_RISCV32_HYDROGEN
```
