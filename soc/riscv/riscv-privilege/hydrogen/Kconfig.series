## soc/riscv/riscv-privilege/hydrogen/Kconfig.series
```kconfig
config SOC_SERIES_RISCV32_HYDROGEN
	bool "Hydrogen implementation"
	select SOC_FAMILY_RISCV_PRIVILEGE
	help
	  Enable support for Hydrogen
```

## soc/riscv/riscv-privilege/hydrogen/Kconfig.soc
```kconfig
choice
prompt "Hydrogen implementations"
depends on SOC_SERIES_RISCV32_HYDROGEN

config SOC_RISCV32_HYDROGEN
	bool "Hydrogen implementation"
	select ATOMIC_OPERATIONS_C

endchoice
```

## soc/riscv/riscv-privileged/elements-vexriscv/Kconfig.series
```kconfig
config SOC_SERIES_RISCV32_ELEMENTS_VEXRISCV
	bool "Elements implementation"
	select SOC_FAMILY_RISCV_PRIVILEGED
	select HAS_DTS
	select INCLUDE_RESET_VECTOR
	help
	  Enable support for Elements SOCs
```
