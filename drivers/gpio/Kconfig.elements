## drivers/gpio/Kconfig.elements
```kconfig
# Kconfig.elements - Elements GPIO configuration option
#
# Copyright (c) 2023 aesc silicon
#
# SPDX-License-Identifier: Apache-2.0
#

menuconfig GPIO_ELEMENTS
	bool "Elements GPIO driver"
	default y
	depends on DT_HAS_ELEMENTS_GPIO_ENABLED
	help
	  Enable driver for the Elements GPIO controller.

	  Says n if not sure.


if GPIO_ELEMENTS

config GPIO_ELEMENTS_INTERRUPT
	bool "Enable interrupt support"

endif # GPIO_ELEMENTS
```

## drivers/gpio/Kconfig.hydrogen
```kconfig
# Kconfig.hydrogen - Hydrogen GPIO configuration option
#
# Copyright (c) 2019 Phytec Messtechnik GmbH
#
# SPDX-License-Identifier: Apache-2.0
#

menuconfig GPIO_HYDROGEN
	bool "Hydrogen GPIO driver"
	depends on GPIO && SOC_SERIES_RISCV32_HYDROGEN
	select HAS_DTS_GPIO
	help
	  Enable driver for the Hydrogen GPIO controller.

	  Says n if not sure.


if GPIO_HYDROGEN

config GPIO_HYDROGEN_INTERRUPT
	bool "Enable interrupt support"

endif # GPIO_HYDROGEN
```

## drivers/i2c/Kconfig.aesc
```kconfig
# SPDX-FileCopyrightText: 2026 Aesc Silicon
# SPDX-License-Identifier: Apache-2.0

config I2C_AESC
	bool "Aesc Silicon I2C controller driver"
	default y
	depends on DT_HAS_AESC_I2C_ENABLED
	help
	  Enable I2C controller support
```

## drivers/i2c/Kconfig.elements
```kconfig
# Kconfig.elements - Elements I2C configuration option
#
# Copyright (c) 2023 aesc silicon
#
# SPDX-License-Identifier: Apache-2.0
#

menuconfig I2C_ELEMENTS
	bool "Elements I2C controller driver"
	depends on SOC_SERIES_RISCV32_ELEMENTS_VEXRISCV
	help
	  Enable the Elements I2C controller driver.
```

## drivers/i2c/Kconfig.hydrogen
```kconfig
# Kconfig.hydrogen - Hydrogen I2C configuration option
#
# Copyright (c) 2020 Phytec Messtechnik GmbH
#
# SPDX-License-Identifier: Apache-2.0
#

menuconfig I2C_HYDROGEN
	bool "Hydrogen I2C controller driver"
	depends on SOC_SERIES_RISCV32_HYDROGEN
	help
	  Enable the Hydrogen I2C controller driver.
```

## drivers/memc/Kconfig.elements
```kconfig
# Copyright (c) 2024, aesc silicon
# SPDX-License-Identifier: Apache-2.0

config MEMC_ELEMENTS_HYPERBUS
	bool "Elements Hyperbus Memory Controller"
	default y
	depends on SOC_RISCV32_ELEMENTS_VEXRISCV
	help
	  Enable driver for Elements Hyperbus Memory Controller.
```

## drivers/misc/pio_aesc/Kconfig
```kconfig
# SPDX-FileCopyrightText: 2026 Aesc Silicon
# SPDX-License-Identifier: Apache-2.0

config PIO_AESC
	bool "Aesc Silicon Programmable IO Controller"
	default y
	depends on DT_HAS_AESC_PIO_ENABLED

if PIO_AESC

module = PIO_AESC
module-str = pio_aesc
source "subsys/logging/Kconfig.template.log_config"

endif # PIO_AESC
```

## drivers/pwm/Kconfig.aesc
```kconfig
# SPDX-FileCopyrightText: 2026 Aesc Silicon
# SPDX-License-Identifier: Apache-2.0

config PWM_AESC
	bool "Aesc Silicon PWM driver"
	default y
	depends on DT_HAS_AESC_PWM_ENABLED
	help
	  Enable the Aesc Silicon PWM driver.
```

## drivers/pwm/Kconfig.elements
```kconfig
# Kconfig.elements - Elements PWM configuration option
#
# Copyright (c) 2024 aesc silicon
#
# SPDX-License-Identifier: Apache-2.0
#

config PWM_ELEMENTS
	bool "Elements  PWM PWM driver"
	depends on SOC_SERIES_RISCV32_ELEMENTS_VEXRISCV
	help
	  Enable the Elements PWM driver.
```

## drivers/reset/Kconfig.elements
```kconfig
# Copyright (c) 2025 aesc silicon
# SPDX-License-Identifier: Apache-2.0

config RESET_ELEMENTS
	bool "ELEMENTS reset driver"
	default y
	depends on DT_HAS_ELEMENTS_RST_ENABLED
	help
	  This option enables the reset driver for Elements reset controller.
```

## drivers/serial/Kconfig.elements
```kconfig
# Kconfig.elements - Elements UART configuration option
#
# Copyright (c) 2023 aesc silicon
#
# SPDX-License-Identifier: Apache-2.0
#

menuconfig UART_ELEMENTS
	bool "Elements UART driver"
	default y
	depends on DT_HAS_ELEMENTS_UART_ENABLED
	select SERIAL_HAS_DRIVER
	select SERIAL_SUPPORT_INTERRUPT
	help
	  Enable the Elements UART driver.
```

## drivers/serial/Kconfig.hydrogen
```kconfig
# Kconfig.hydrogen - Hydrogen UART configuration option
#
# Copyright (c) 2019 Phytec Messtechnik GmbH
#
# SPDX-License-Identifier: Apache-2.0
#

menuconfig UART_HYDROGEN
	bool "Hydrogen UART driver"
	depends on SOC_SERIES_RISCV32_HYDROGEN
	select SERIAL_HAS_DRIVER
#	select SERIAL_SUPPORT_INTERRUPT
	help
	  Enable the Hydrogen UART driver.
```

## drivers/spi/Kconfig.elements
```kconfig
# Kconfig.elements - Elements SPI configuration option
#
# Copyright (c) 2023 aesc silicon
#
# SPDX-License-Identifier: Apache-2.0
#

menuconfig SPI_ELEMENTS
	bool "Elements SPI controller driver"
	depends on SOC_SERIES_RISCV32_ELEMENTS_VEXRISCV
	help
	  Enable the Elements SPI driver.
```

## drivers/spi/Kconfig.hydrogen
```kconfig
# Kconfig.hydrogen - Hydrogen SPI configuration option
#
# Copyright (c) 2019 Phytec Messtechnik GmbH
#
# SPDX-License-Identifier: Apache-2.0
#

menuconfig SPI_HYDROGEN
	bool "Hydrogen SPI controller driver"
	depends on SOC_SERIES_RISCV32_HYDROGEN
	help
	  Enable the Hydrogen SPI driver.
```

## dts/bindings/cpu/spinalhdl,vexiiriscv.yaml
```yaml
# Copyright (c) 2026 Daniel Schultz <dnltz@aesc-silicon.de>
# SPDX-License-Identifier: Apache-2.0

description: VexiiRiscv RISC-V CPU

compatible: "spinalhdl,vexiiriscv"

include: riscv-common.yaml
```

## dts/bindings/flash_controller/aesc,spi-flash-controller.yaml
```yaml
# SPDX-FileCopyrightText: 2026 Aesc Silicon
# SPDX-License-Identifier: Apache-2.0

description: |
  Aesc Silicon SPI flash controller.

  Exposes the execute-in-place (XIP) mapped SPI NOR flash as a read-only flash
  device. The flash region is described by a soc-nv-flash child node, e.g.:

    flash_controller: flash-controller@f0024000 {
        compatible = "aesc,spi-flash-controller";
        reg = <0xf0024000 0x2000>;
        #address-cells = <1>;
        #size-cells = <1>;

        flash0: flash@a0010000 {
            compatible = "soc-nv-flash";
            reg = <0xa0010000 DT_SIZE_K(512)>;
        };
    };

compatible: "aesc,spi-flash-controller"

include: flash-controller.yaml

properties:
  aesc,quad-mode:
    type: boolean
    description: |
      Switch the XIP controller to quad (4-bit) SPI protocol at driver init.
      Use this when no first-stage bootloader has already configured the
      flash interface. When absent, the controller keeps its reset (single
      bit) read mode.
```

## dts/bindings/gpio/elements,gpio.yaml
```yaml
#
# Copyright (c) 2021 Phytec Messtechnik GmbH
#
# SPDX-License-Identifier: Apache-2.0
#
---
compatible: "elements,gpio"

description: Elements GPIO - This is a representation of the Elements GPIO nodes

include: [gpio-controller.yaml, base.yaml]

properties:
    reg:
      required: true

    interrupts:
      required: true

    "#gpio-cells":
      const: 2

gpio-cells:
  - pin
  - flags
```

## dts/bindings/gpio/hydrogen,gpio.yaml
```yaml
#
# Copyright (c) 2019 Phytec Messtechnik GmbH
#
# SPDX-License-Identifier: Apache-2.0
#
---
compatible: "hydrogen,gpio"

description: Hydrogen GPIO - This is a representation of the Hydrogen GPIO nodes

include: [gpio-controller.yaml, base.yaml]

properties:
    reg:
      required: true

    label:
      required: true

    interrupts:
      required: true

    "#gpio-cells":
      const: 2

gpio-cells:
  - pin
  - flags
```

## dts/bindings/i2c/aesc,i2c.yaml
```yaml
# SPDX-FileCopyrightText: 2026 Aesc Silicon
# SPDX-License-Identifier: Apache-2.0

title: Aesc Silicon I2C Controller

description: |
  Aesc Silicon I2C controller IP core. Supports standard mode (100 kHz),
  fast mode (400 kHz), and fast-plus mode (1 MHz).

compatible: "aesc,i2c"

include: [i2c-controller.yaml, pinctrl-device.yaml]

properties:
  reg:
    required: true

  interrupts:
    required: true

  input-frequency:
    type: int
    required: true
    description: |
      System clock frequency in Hz fed into the IP core clock divider.
      Used together with clock-frequency to compute the divider register value.

  clock-frequency:
    required: true
    description: |
      Target I2C SCL frequency in Hz. Supported values are 100000 (standard),
      400000 (fast), and 1000000 (fast-plus).

  pinctrl-0:
    description: |
      Pin configuration for the SCL and SDA signals.
      Phandles must reference pinctrl nodes for the I2C peripheral signals.
      Example: pinctrl-0 = <&i2c0_scl &i2c0_sda>;
    required: true

  pinctrl-names:
    required: true
```

## dts/bindings/i2c/elements,i2c.yaml
```yaml
#
# Copyright (c) 2021 Phytec Messtechnik GmbH
#
# SPDX-License-Identifier: Apache-2.0
#
---

description: Elements I2C - This binding gives a base representation of the Elements I2C Controller

compatible: "elements,i2c"

include: i2c-controller.yaml

properties:
    input-frequency:
      type: int
      required: false
      description: Frequency of the peripheral input clock.
```

## dts/bindings/i2c/hydrogen,i2c.yaml
```yaml
#
# Copyright (c) 2020 Phytec Messtechnik GmbH
#
# SPDX-License-Identifier: Apache-2.0
#
---

description: Hydrogen I2C - This binding gives a base representation of the Hydrogen I2C Controller

compatible: "hydrogen,i2c"

include: i2c-controller.yaml

properties:
    input-frequency:
      type: int
      required: false
      description: Frequency of the peripheral input clock.
```

## dts/bindings/i2c/i2c-controller.yaml
```yaml
# Copyright (c) 2017 I-SENSE group of ICCS
# SPDX-License-Identifier: Apache-2.0

# Common fields for I2C controllers

include: base.yaml

bus: i2c

properties:
    clock-frequency:
      type: int
      required: false
      description: Initial clock frequency in Hz
    label:
      required: true
```

## dts/bindings/interrupt-controller/elements,plic-0.yaml
```yaml
# Copyright (c) 2018, SiFive Inc.
# SPDX-License-Identifier: Apache-2.0

# Copy of elements,plic-1.0.0.yaml

description: Elements RISCV-V platform-local interrupt controller

compatible: "elements,plic-0"

include: riscv,plic0.yaml

properties:
    riscv,ndev:
        type: int
        description: Number of external interrupts supported
        required: true
```

## dts/bindings/interrupt-controller/hydrogen,plic-0.yaml
```yaml
# Copyright (c) 2018, SiFive Inc.
# SPDX-License-Identifier: Apache-2.0

# Copy of hydrogen,plic-1.0.0.yaml

description: Hydrogen RISCV-V platform-local interrupt controller

compatible: "hydrogen,plic-0"

include: riscv,plic0.yaml

properties:
    riscv,ndev:
        type: int
        description: Number of external interrupts supported
        required: true
```

## dts/bindings/memory-controllers/elements,hyperbus.yaml
```yaml
# Copyright (c) 2024, aesc silicon
# SPDX-License-Identifier: Apache-2.0

description: Elements Hyperbus Controller.

compatible: "elements,hyperbus"

include: [base.yaml]

properties:
  reg:
    required: true

  latency-cycles:
    type: int

  variable-latency:
    type: boolean
```
