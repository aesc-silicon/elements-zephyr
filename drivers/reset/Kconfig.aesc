## drivers/reset/Kconfig.aesc
```kconfig
# SPDX-FileCopyrightText: 2026 Aesc Silicon
# SPDX-License-Identifier: Apache-2.0

config RESET_AESC
	bool "Aesc Silicon reset controller driver"
	default y
	depends on DT_HAS_AESC_RESET_CONTROLLER_ENABLED
	help
	  Enable the Aesc Silicon reset controller driver. The IP core only
	  supports pulsing a reset domain, so only reset_line_toggle() is
	  implemented.
```

## dts/bindings/reset/aesc,reset-controller.yaml
```yaml
#
# SPDX-FileCopyrightText: 2026 Aesc Silicon
#
# SPDX-License-Identifier: Apache-2.0
#

title: Aesc Silicon Reset Controller

description: |
  Reset controller for the ElemRV platform. Software requests a reset of one
  or more reset domains; each requested domain is held in reset for a delay
  defined by the SoC and released afterwards. A domain cannot be held in reset
  by software.

  The reset specifier is the zero-based domain index, e.g. HYDROGEN_RESET_SYSTEM.

compatible: "aesc,reset-controller"

include: [reset-controller.yaml, base.yaml]

properties:
  reg:
    required: true

  "#reset-cells":
    const: 1

reset-cells:
  - id
```
