## boards/aesc/elemrv/Kconfig.elemrv
```kconfig
# SPDX-FileCopyrightText: 2025 Aesc Silicon
# SPDX-License-Identifier: Apache-2.0

config BOARD_ELEMRV
	select SOC_ELEMRV_H if BOARD_ELEMRV_ELEMRV_H
	select SOC_ELEMRV_N if BOARD_ELEMRV_ELEMRV_N
```

## boards/aesc/elemrv/board.yml
```yaml
board:
  name: elemrv
  full_name: ElemRV Microcontroller
  vendor: aesc
  socs:
  - name: elemrv-n
```

## boards/aesc/elemrv/elemrv_elemrv-n_defconfig
```kconfig
# Copyright (c) 2025 aesc silicon
# SPDX-License-Identifier: Apache-2.0

# Serial Driver
CONFIG_SERIAL=y

# GPIO Driver
CONFIG_GPIO=y
#CONFIG_GPIO_ELEMENTS_INTERRUPT=y

# Enable Console
CONFIG_CONSOLE=y
CONFIG_UART_CONSOLE=y

#CONFIG_DEBUG_COREDUMP=y
#CONFIG_DEBUG_COREDUMP_BACKEND_LOGGING=y
#CONFIG_LOG=y
#CONFIG_LOG_MODE_IMMEDIATE=y
```

## boards/aesc/elemrv/elemrv_elemrv1_defconfig
```kconfig
# Copyright (c) 2025 aesc silicon
# SPDX-License-Identifier: Apache-2.0

# Serial Driver
CONFIG_SERIAL=y

# GPIO Driver
CONFIG_GPIO=y

# Enable Console
CONFIG_CONSOLE=y
CONFIG_UART_CONSOLE=y
```

## boards/aesc/elemrv_flask/elemrv_flask_elemrv_h_defconfig
```kconfig
# SPDX-FileCopyrightText: 2026 Aesc Silicon
# SPDX-License-Identifier: Apache-2.0

# Serial Driver
CONFIG_SERIAL=y

# Enable Console
CONFIG_CONSOLE=y
CONFIG_UART_CONSOLE=y

# GPIO Driver
CONFIG_GPIO=y

# Link the application into the code partition (after the bootloader sector)
CONFIG_USE_DT_CODE_PARTITION=y
```

## boards/others/elemrv/board.yml
```yaml
board:
  name: elemrv
  full_name: ElemRV-N
  vendor: others
  socs:
  - name: elemrv-n
```

## boards/riscv/argon/Kconfig.board
```kconfig
config BOARD_ARGON1_ECPIX5
    bool "Argon1 ECPIX-5 Board"
    depends on SOC_RISCV32_ELEMENTS_VEXRISCV
    select HAS_DTS
    select RISCV
```

## boards/riscv/helium/Kconfig.board
```kconfig
config BOARD_HELIUM1_NEXYSA7
    bool "Helium1 Nexys A7 board"
    depends on SOC_RISCV32_ELEMENTS_VEXRISCV
    select HAS_DTS
    select RISCV

config BOARD_HELIUM1_ECPIX5
    bool "Helium1 ECPIX-5 board"
    depends on SOC_RISCV32_ELEMENTS_VEXRISCV
    select HAS_DTS
    select RISCV
```

## boards/riscv/hydrogen/Kconfig.board
```kconfig
config BOARD_HYDROGEN1_NEXYSA7
    bool "Hydrogen1 Nexys A7 board"
    depends on SOC_RISCV32_ELEMENTS_VEXRISCV
    select HAS_DTS
    select RISCV
```

## boards/riscv/hydrogen/Kconfig.defconfig
```kconfig
if BOARD_HYDROGEN1_NEXYS4DDR
config BOARD
    default "hydrogen1-nexys4ddr"
endif
```

## boards/riscv/hydrogen/dh006_defconfig
```kconfig
CONFIG_SOC_SERIES_RISCV32_HYDROGEN=y
CONFIG_SOC_RISCV32_HYDROGEN=y
CONFIG_BOARD_HYDROGEN_DH006=y
CONFIG_HEAP_MEM_POOL_SIZE=1024

CONFIG_RISCV_MACHINE_TIMER=y
CONFIG_RISCV_HAS_PLIC=y
CONFIG_PLIC=y

CONFIG_CONSOLE=y
CONFIG_PRINTK=y
CONFIG_SERIAL=y
CONFIG_UART_HYDROGEN=y
CONFIG_UART_CONSOLE=y

CONFIG_GPIO=y
CONFIG_GPIO_HYDROGEN=y

CONFIG_SPI=y
CONFIG_SPI_HYDROGEN=y

CONFIG_BOOT_BANNER=y

# Configs to enable a shell
CONFIG_SHELL=y
CONFIG_GPIO_SHELL=y
CONFIG_LOG=y

CONFIG_XIP=n

CONFIG_GEN_ISR_TABLES=y
```

## boards/riscv/hydrogen/dh008_defconfig
```kconfig
CONFIG_SOC_SERIES_RISCV32_HYDROGEN=y
CONFIG_SOC_RISCV32_HYDROGEN=y
CONFIG_BOARD_HYDROGEN_DH008=y
CONFIG_HEAP_MEM_POOL_SIZE=1024

CONFIG_SERIAL=y
CONFIG_UART_HYDROGEN=y
CONFIG_UART_INTERRUPT_DRIVEN=y
CONFIG_GPIO=y
CONFIG_GPIO_HYDROGEN=y
CONFIG_GPIO_HYDROGEN_INTERRUPT=y
CONFIG_SPI=y
CONFIG_SPI_HYDROGEN=y
CONFIG_I2C=y
CONFIG_I2C_HYDROGEN=y

CONFIG_XIP=n
```

## boards/riscv/hydrogen/hydrogen1-ecpix5_defconfig
```kconfig
CONFIG_SOC_SERIES_RISCV32_ELEMENTS_VEXRISCV=y
CONFIG_SOC_RISCV32_ELEMENTS_VEXRISCV=y
CONFIG_BOARD_HYDROGEN1_ECPIX5=y
CONFIG_HEAP_MEM_POOL_SIZE=1024
CONFIG_SYS_CLOCK_HW_CYCLES_PER_SEC=100000000
CONFIG_SYS_CLOCK_TICKS_PER_SEC=1000
CONFIG_XIP=n
CONFIG_GPIO=y
CONFIG_GPIO_ELEMENTS=y
CONFIG_GPIO_ELEMENTS_INTERRUPT=y
CONFIG_SERIAL=y
CONFIG_UART_ELEMENTS=y
CONFIG_UART_INTERRUPT_DRIVEN=n
CONFIG_REBOOT=y
```

## boards/riscv/hydrogen_th/Kconfig.board
```kconfig
config BOARD_HYDROGEN_TH283
	bool "Hydrogen Test Hardware board"
	depends on SOC_RISCV32_HYDROGEN
	select HAS_DTS
	select RISCV

config BOARD_HYDROGEN_TH294
	bool "Hydrogen Test Hardware board"
	depends on SOC_RISCV32_HYDROGEN
	select HAS_DTS
	select RISCV
```

## boards/riscv/lithium/Kconfig.board
```kconfig
config BOARD_LITHIUM1_ECPIX5
    bool "Lithium1 ECPIX-5 Board"
    depends on SOC_RISCV32_ELEMENTS_VEXRISCV
    select HAS_DTS
    select RISCV
```

## boards/riscv/neon/Kconfig.board
```kconfig
config BOARD_NEON1_NEXYSA7
    bool "Neon1 Nexys A7 board"
    depends on SOC_RISCV32_ELEMENTS_VEXRISCV
    select HAS_DTS
    select RISCV

config BOARD_NEON1_ECPIX5
    bool "Neon1 ECPIX-5 board"
    depends on SOC_RISCV32_ELEMENTS_VEXRISCV
    select HAS_DTS
    select RISCV
```

## boards/riscv/neon/Kconfig.defconfig
```kconfig
if BOARD_NEON1_NEXYSA7
config BOARD
    default "neon1-nexysa7"
endif

if BOARD_NEON1_ECPIX5
config BOARD
    default "neon1-ecpix5"
endif
```

## boards/riscv/nitrogen/Kconfig.board
```kconfig
config BOARD_NITROGEN1_ECPIX5
    bool "Nitrogen1 ECPIX-5 Board"
    depends on SOC_RISCV32_ELEMENTS_VEXRISCV
    select HAS_DTS
    select RISCV
```

## boards/riscv/nitrogen/nitrogen1-ecpix5_defconfig
```kconfig
CONFIG_SOC_RISCV32_ELEMENTS_VEXRISCV=y
CONFIG_BOARD_NITROGEN1_ECPIX5=y
CONFIG_HEAP_MEM_POOL_SIZE=1024
CONFIG_SYS_CLOCK_HW_CYCLES_PER_SEC=100000000
CONFIG_SYS_CLOCK_TICKS_PER_SEC=100
CONFIG_XIP=n
CONFIG_REBOOT=y
CONFIG_GPIO=y
CONFIG_GPIO_ELEMENTS=y
CONFIG_GPIO_ELEMENTS_INTERRUPT=y
CONFIG_SERIAL=y
CONFIG_UART_ELEMENTS=y
CONFIG_UART_INTERRUPT_DRIVEN=n
CONFIG_MEMC=y
CONFIG_MEMC_ELEMENTS_HYPERBUS=y
CONFIG_SPI=y
CONFIG_SPI_ELEMENTS=y
CONFIG_PRINTK=y
CONFIG_CONSOLE=y
CONFIG_UART_CONSOLE=y
CONFIG_LOG=y
```
